LCD_E 	BIT P3.4
LCD_RS 	BIT	P3.5
LCDADDR	EQU	6000H

HOUR	EQU	30H
MINUTE	EQU	31H
SECOND	EQU	32H

MODE	EQU	33H
SUB_MD	EQU	34H
MD_SET	EQU	1
MD_RUN	EQU	2
MD_STOP	EQU	3
ST_HOUR	EQU	11
ST_MIN	EQU	12
ST_SEC	EQU	13

T0CNT	EQU	35H
LOAD_T0	EQU	61440
ROLL_T0	EQU	15

TGL_BIT	BIT	2FH.0
OUT_SET	BIT	2FH.1
INC_SET	BIT	P1.0
DEC_SET	BIT	P1.1
EX0_BUT	BIT	P3.2

COL_LCD	EQU	05H
ROW_LCD	EQU	04H


ORG		0000H
LJMP	MAIN

ORG		0003H
LJMP	E0ISR

ORG		000BH
LJMP	T0ISR

ORG		0030H
MAIN:
	; Initialize generally
	MOV		MODE, #MD_STOP
	MOV		SUB_MD, #ST_HOUR

	; Initialize Timer 0 Mode 1
	MOV		TMOD, #01H
	MOV		T0CNT, #ROLL_T0

	; Initialize Interrupt
	SETB	EA
	SETB	ET0
	SETB	EX0
	SETB	PX0
	SETB	IT0

	; Initialize LCD 16x2
	MOV		DPTR, #LCDADDR
	ACALL	CLEAR
	ACALL	INIT_LCD
	; Force External Interrupt
	CLR		INT0	 
	MAIN_LOOP:
		JB		OUT_SET, MAIN_SETTING
		JMP		MAIN_OUT	
		MAIN_SETTING:
			ACALL	SETTING_TOTAL
		MAIN_OUT:
		ACALL	DISPLAY_LCD	
	
	SJMP	MAIN_LOOP

SETTING_TOTAL: ;Put register hour/minute/second to R0
	MOV		A, @R0
	
	SETTING_INCREASE:
	JB		INC_SET, SETTING_DECREASE
	ACALL	DELAY_100MS
	JB		INC_SET, SETTING_DECREASE
	ACALL	DELAY_100MS
	JNB		INC_SET, SETTING_DECREASE
	INC		A
	JMP		OUT_SETTING

	SETTING_DECREASE:
	JB		DEC_SET, OUT_SETTING
	ACALL	DELAY_100MS
	JB		DEC_SET, OUT_SETTING
	ACALL	DELAY_100MS
	JNB		DEC_SET, OUT_SETTING
	JZ		OUT_SETTING
	DEC		A	

	OUT_SETTING:
	MOV		@R0, A
	RET

DELAY_100MS:
	MOV		R6, #200
	LOOP_DELAY_75MS:
		MOV 	R7, #250
		DJNZ	R7, $
		DJNZ	R6, LOOP_DELAY_75MS	
	RET

; Interrupts below
E0ISR:
	ACALL	DELAY_100MS		
	JB		EX0_BUT, EX0_OUT
	ACALL	DELAY_100MS
	JNB		EX0_BUT, EX0_OUT

	MOV		A, MODE
	EX0_SETTING:
		CJNE	A, #MD_SET, EX0_RUNNING
		MOV		A, SUB_MD

		EX0_SET_HOUR:
			CJNE	A, #ST_HOUR, EX0_SET_MINUTE
			MOV		SUB_MD, #ST_MIN
			MOV		R0, #MINUTE
			SETB	OUT_SET
			JMP		EX0_OUT

		EX0_SET_MINUTE:
			CJNE	A, #ST_MIN, EX0_SET_SECOND
			MOV		SUB_MD, #ST_SEC
			MOV		R0, #SECOND
			SETB	OUT_SET
			JMP		EX0_OUT

		EX0_SET_SECOND:
			CJNE	A, #ST_SEC, EX0_RUNNING
			MOV		MODE, #MD_RUN
			CLR		OUT_SET
			SETB	TF0
			JMP		EX0_OUT

	EX0_RUNNING:
		CJNE	A, #MD_RUN, EX0_STOPPED
		MOV		MODE, #MD_STOP
		CLR		TR0
		CLR		TF0
		JMP		EX0_OUT
	
	EX0_STOPPED:
		CJNE	A, #MD_STOP, EX0_OUT
		MOV		MODE, #MD_SET
		MOV		SUB_MD, #ST_HOUR
		MOV		R0, #HOUR
		SETB	OUT_SET

	EX0_OUT:
		SETB	INT0
	RETI

T0ISR:
	DJNZ	T0CNT, RUNT0
	MOV		T0CNT, #ROLL_T0
	CPL		TGL_BIT
	INC		SECOND
	RUNT0:
		CLR		TR0
		MOV		TH0, #HIGH(-LOAD_T0)
		MOV		TL0, #LOW(-LOAD_T0)
		SETB	TR0
	RETI

; LCD Functions below
DISPLAY_LCD:
	MOV		COL_LCD, #4
	MOV		ROW_LCD, #1
	ACALL	GOTOXY 
	MOV		A, MODE
	SETTING_MODE:
		CJNE	A, #MD_SET, RUNNING_MODE
		MOV		A, SUB_MD
		SET_HOUR_MODE:
			CJNE	A, #ST_HOUR, SET_MINUTE_MODE
			MOV		A, #'h'
			ACALL	WRITETEXT
			JMP		OUT_SETTING_MODE
		SET_MINUTE_MODE:
			CJNE	A, #ST_MIN, SET_SECOND_MODE
			MOV		A, #'m'
			ACALL	WRITETEXT
			JMP		OUT_SETTING_MODE
		SET_SECOND_MODE:
			CJNE	A, #ST_SEC, OUT_SETTING_MODE
			MOV		A, #'s'
			ACALL	WRITETEXT
		OUT_SETTING_MODE:
		MOV		A, #'_'
		ACALL	WRITETEXT
		MOV		DPTR, #MESSAGE_SETTING
		JMP		OUTPUTLCD
 
	RUNNING_MODE:
		CJNE	A, #MD_RUN, STOPPED_MODE
		MOV		DPTR, #MESSAGE_RUNNING
		JMP		OUTPUTLCD
	
	STOPPED_MODE:
		CJNE	A, #MD_STOP, OUTPUTLCD
		MOV		DPTR, #MESSAGE_STOPPED

	OUTPUTLCD:
		ACALL	SUB_DISPLAY_LCD

		MOV		R2, SECOND
		CJNE	R2, #60, CHECK_MINUTE
		MOV		SECOND, #0
		INC		MINUTE
	    
		CHECK_MINUTE:
		MOV		R2, MINUTE
		CJNE	R2, #60, CHECK_HOUR
		MOV		MINUTE, #0
		INC		HOUR
	
		CHECK_HOUR:
		MOV		R2, HOUR
		CJNE	R2, #24, SUB_OUTPUTLCD
		MOV		HOUR, #0

		SUB_OUTPUTLCD:
		MOV		COL_LCD, #4
		MOV		ROW_LCD, #0
		ACALL	GOTOXY
		; Write hour
		MOV		A, HOUR
		ACALL	WRITENUMBER
		ACALL	WRITECOLON
		; Write minute
		MOV		A, MINUTE
		ACALL	WRITENUMBER
		ACALL	WRITECOLON
		; Write second
		MOV		A, SECOND
		ACALL	WRITENUMBER
	RET
WRITENUMBER:   ; Move register hour/minute/second to A
	MOV		B, #10
	DIV		AB
	ADD		A, #30H
	ACALL	WRITETEXT
	MOV		A, B
	ADD		A, #30H
	ACALL	WRITETEXT
	RET

WRITECOLON:
	JB		TGL_BIT, NO_COLON
	COLON:
		MOV		A, #':'
		ACALL	WRITETEXT
		SJMP	$+6
	NO_COLON:
		MOV		A, #' '
		ACALL	WRITETEXT
	RET

GOTOXY: ; Column: R5 (#0->#15); Row: R4 (#0->#1)
	SETB	C
	MOV		A, ROW_LCD
	PUSH	ROW_LCD
	INC		ROW_LCD
	LOOP_GOTOXY:
		RRC		A
		DJNZ	ROW_LCD, LOOP_GOTOXY
	POP		ROW_LCD
	ADD		A, COL_LCD
	ACALL	WRITECOM
	RET

INIT_LCD:
	MOV		A, #38H
	ACALL	WRITECOM
	MOV		A, #0CH
	ACALL	WRITECOM
	MOV		A, #06H
	ACALL	WRITECOM
	RET

CLEAR:
	MOV		A, #01H
	ACALL	WRITECOM
	RET

WRITECOM:
	PUSH	DPH
	PUSH	DPL
	MOV		DPTR, #LCDADDR
	SETB	LCD_E
	CLR		LCD_RS
	MOVX	@DPTR, A
	CLR		LCD_E
	ACALL	WAIT_LCD
	POP		DPL
	POP		DPH
	RET

WRITETEXT:
	PUSH	DPH
	PUSH	DPL
	MOV		DPTR, #LCDADDR
	SETB	LCD_E
	SETB	LCD_RS
	MOVX	@DPTR, A
	CLR		LCD_E
	ACALL	WAIT_LCD
	POP		DPL
	POP		DPH
	RET

SUB_DISPLAY_LCD: ; Store string address in DPTR
	MOV		A, #0
	LOOP_SUB_DISPLAY:
		MOV		R1, A
		MOVC	A, @A+DPTR
		JZ		EXIT_SUB_DISPLAY
		ACALL	WRITETEXT
		MOV		A, R1
		INC 	A
		DJNZ	B, LOOP_SUB_DISPLAY
	EXIT_SUB_DISPLAY:
	RET

WAIT_LCD:
	MOV		R6, #10
	LOOP_WAIT_LCD:
		MOV 	R7, #250
		DJNZ	R7, $
		DJNZ	R6, LOOP_WAIT_LCD
	RET
	  
MESSAGE_SETTING:
	DB	"SETTING",0
MESSAGE_STOPPED:
	DB	"STOPPED  ",0
MESSAGE_RUNNING:
	DB	"RUNNING..",0

END
